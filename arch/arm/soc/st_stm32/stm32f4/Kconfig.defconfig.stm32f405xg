## arch/arm/soc/st_stm32/stm32f4/Kconfig.defconfig.stm32f405xg
```kconfig
# Kconfig - ST STM32F405xG MCU configuration options
#
# Copyright (c) 2017 Christer Weinigel
#
# Licensed under the Apache License, Version 2.0 (the "License");
# you may not use this file except in compliance with the License.
# You may obtain a copy of the License at
#
#     http://www.apache.org/licenses/LICENSE-2.0
#
# Unless required by applicable law or agreed to in writing, software
# distributed under the License is distributed on an "AS IS" BASIS,
# WITHOUT WARRANTIES OR CONDITIONS OF ANY KIND, either express or implied.
# See the License for the specific language governing permissions and
# limitations under the License.
#

if SOC_STM32F405XG

config SOC
	string
	default stm32f405xx

config SRAM_SIZE
	default 112

config FLASH_SIZE
	default 1024

config NUM_IRQS
	int
	default 82

config USB_DC_STM_EP_NUM
	int
	default 4

config USB_DC_STM_PACKET_RAM_SIZE
	int
	default 1280

endif # SOC_STM32F405XG
```

## boards/arm/weinigel_stm_stepper/Kconfig.defconfig
```kconfig
# Kconfig - Weinigel STM-STEPPER STMF405VG board configuration
#
# Copyright (c) 2016 Christer Weinigel
#
# Licensed under the Apache License, Version 2.0 (the "License");
# you may not use this file except in compliance with the License.
# You may obtain a copy of the License at
#
#     http://www.apache.org/licenses/LICENSE-2.0
#
# Unless required by applicable law or agreed to in writing, software
# distributed under the License is distributed on an "AS IS" BASIS,
# WITHOUT WARRANTIES OR CONDITIONS OF ANY KIND, either express or implied.
# See the License for the specific language governing permissions and
# limitations under the License.
#

if BOARD_WEINIGEL_STM_STEPPER

config BOARD
	default weinigel_stm_stepper

endif # BOARD_WEINIGEL_STM_STEPPER
```

## boards/arm/weinigel_stm_stepper/weinigel_stm_stepper_defconfig
```kconfig
CONFIG_ARM=y
CONFIG_BOARD_WEINIGEL_STM_STEPPER=y
CONFIG_SOC_SERIES_STM32F4X=y
CONFIG_SOC_STM32F405XG=y
# 84MHz system clock
CONFIG_SYS_CLOCK_HW_CYCLES_PER_SEC=84000000
CONFIG_SYS_CLOCK_TICKS_PER_SEC=1000

CONFIG_USB=y
CONFIG_USB_DC_STM=y
CONFIG_USB_CDC_ACM=y
CONFIG_USB_DEVICE_STACK=y
# CONFIG_SYS_LOG_USB_CDC_ACM_LEVEL=4
# CONFIG_SYS_LOG_USB_LEVEL=4
# CONFIG_SYS_LOG_USB_DC_STM_LEVEL=4
CONFIG_SYS_LOG=y

CONFIG_UART_STM32_PORT_1=y
CONFIG_UART_STM32_PORT_1_BAUD_RATE=115200
CONFIG_UART_STM32_PORT_2=y
CONFIG_UART_STM32_PORT_2_BAUD_RATE=115200

CONFIG_UART_CONSOLE_ON_DEV_NAME="UART_2"
# CONFIG_UART_CONSOLE_ON_DEV_NAME="CDC_ACM"

CONFIG_UART_INTERRUPT_DRIVEN=y

# enable pinmux
CONFIG_PINMUX=y

# enable GPIO ports A, B, C, D
CONFIG_GPIO=y
CONFIG_GPIO_STM32_PORTA=y
CONFIG_GPIO_STM32_PORTB=y
CONFIG_GPIO_STM32_PORTC=y
CONFIG_GPIO_STM32_PORTD=y

# clock configuration
CONFIG_CLOCK_CONTROL=y
CONFIG_CLOCK_STM32F4X_SYSCLK_SRC_PLL=y
# use HSE as PLL input
CONFIG_CLOCK_STM32F4X_PLL_SRC_HSE=y
# CONFIG_CLOCK_STM32F4X_HSE_BYPASS=y
# produce 84MHz clock at PLL output
CONFIG_CLOCK_STM32F4X_PLLM_DIV_FACTOR=8
CONFIG_CLOCK_STM32F4X_PLLN_MULTIPLIER=336
CONFIG_CLOCK_STM32F4X_PLLP_DIV_FACTOR=4
CONFIG_CLOCK_STM32F4X_PLLQ_DIV_FACTOR=7
CONFIG_CLOCK_STM32F4X_AHB_PRESCALER=0
CONFIG_CLOCK_STM32F4X_APB1_PRESCALER=2
CONFIG_CLOCK_STM32F4X_APB2_PRESCALER=4
CONFIG_CLOCK_STM32F4X_FLASH_LATENCY=2
```
